## main/Kconfig.projbuild
```kconfig
menu "Configuration"

    config MY_IP
        string "My IP (AP mode)"
        default "http://192.168.4.1"
        help 
            AP IP.

    config MY_DEVICE_NAME
        string "Device name"
        default "dwinScreen"
        help 
            Name device for espnow data.

    config AP_WIFI_SSID
        string "AP name"
        default "NASA"
        help 
            name AP.

    config AP_WIFI_PWD
        string "AP password"
        default "dwin Second"
        help 
            AP password.
            
    config ESPNOW_PMK
        string "ESPNOW primary master key"
        default "pmk1234567890123"
        help
            ESPNOW primary master for the example to use. The length of ESPNOW primary master must be 16 bytes.

    config ESPNOW_LMK
        string "ESPNOW local master key"
        default "lmk1234567890123"
        help
            ESPNOW local master for the example to use. The length of ESPNOW local master must be 16 bytes.

    config ESPNOW_CHANNEL
        int "Channel"
        default 0
        range 0 14
        help
            The channel on which sending and receiving ESPNOW data.
    config AP_WIFI_CHANNEL
        int "Channel"
        default 1
        range 0 14
        help
            The channel AP.

    config ESPNOW_ENABLE_LONG_RANGE
        bool "Enable Long Range"
        default "n"
        help
            When enable long range, the PHY rate of ESP32 will be 512Kbps or 256Kbps

endmenu
```
